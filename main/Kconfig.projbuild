## main/Kconfig.projbuild
```kconfig
menu "SilbapRemoteStick"
config SILBAP_DEV_CDC
    bool "Development build: add a CDC serial console next to MSC"
    default n
choice SILBAP_SD_FREQ
    prompt "SD bus clock"
    default SILBAP_SD_FREQ_DEFAULT
    config SILBAP_SD_FREQ_DEFAULT
        bool "20 MHz (SDMMC_FREQ_DEFAULT)"
    config SILBAP_SD_FREQ_HIGHSPEED
        bool "40 MHz (SDMMC_FREQ_HIGHSPEED)"
endchoice
choice SILBAP_SD_WIDTH
    prompt "SD bus width"
    default SILBAP_SD_WIDTH_4
    config SILBAP_SD_WIDTH_4
        bool "4-bit"
    config SILBAP_SD_WIDTH_1
        bool "1-bit"
endchoice
endmenu
```

## sdkconfig.defaults
```kconfig
CONFIG_IDF_TARGET="esp32s3"
CONFIG_ESPTOOLPY_FLASHSIZE_16MB=y
CONFIG_PARTITION_TABLE_CUSTOM=y
CONFIG_PARTITION_TABLE_CUSTOM_FILENAME="partitions.csv"
CONFIG_ESP_CONSOLE_SECONDARY_NONE=y
CONFIG_FATFS_LFN_HEAP=y
CONFIG_FATFS_MAX_LFN=255
CONFIG_FATFS_API_ENCODING_UTF_8=y
CONFIG_FATFS_USE_LABEL=y
CONFIG_TINYUSB_MSC_ENABLED=y
CONFIG_TINYUSB_CDC_ENABLED=n
CONFIG_TINYUSB_MSC_BUFSIZE=8192
CONFIG_TINYUSB_DESC_MANUFACTURER_STRING="Silbap"
CONFIG_TINYUSB_DESC_PRODUCT_STRING="SilbapRemoteStick"
CONFIG_ESP_MAIN_TASK_STACK_SIZE=8192
CONFIG_ESP_TASK_WDT_TIMEOUT_S=10
# Plan 2: Wi-Fi + TCP throughput
CONFIG_ESP_WIFI_SOFTAP_SUPPORT=y
CONFIG_LWIP_TCP_WND_DEFAULT=32768
CONFIG_LWIP_TCP_SND_BUF_DEFAULT=32768
CONFIG_LWIP_TCP_RECVMBOX_SIZE=32
CONFIG_LWIP_TCPIP_RECVMBOX_SIZE=64
CONFIG_ESP_WIFI_DYNAMIC_RX_BUFFER_NUM=32
CONFIG_ESP_WIFI_STATIC_RX_BUFFER_NUM=10
CONFIG_ESP_WIFI_IRAM_OPT=y
CONFIG_LWIP_IRAM_OPTIMIZATION=y
# WebDAV: percent-encoded Korean paths (9 bytes per syllable) need long URIs (struct httpd_req holds one)
CONFIG_HTTPD_MAX_URI_LEN=2048
```
